## main/Kconfig.projbuild
```kconfig
menu "Locator Configuration"

    config LOCATOR_SCAN_INTERVAL_SEC
        int "Deep sleep scan interval (seconds)"
        default 30
        range 10 3600
        help
            Interval between WiFi scans during deep sleep cycles.

    config LOCATOR_MAX_STORED_SCANS
        int "Maximum stored scans in NVS"
        default 500
        range 10 1000
        help
            Maximum number of scan records stored in NVS.
            Oldest scans are evicted when this limit is reached.

    config LOCATOR_MAX_APS_PER_SCAN
        int "Maximum APs per scan"
        default 10
        range 5 30
        help
            Maximum number of access points to record per scan.

    config LOCATOR_BOOT_BUTTON_GPIO
        int "Boot button GPIO number"
        default 9 if IDF_TARGET_ESP32C3 || IDF_TARGET_ESP32C2 || IDF_TARGET_ESP32C6 || IDF_TARGET_ESP32H2
        default 0
        help
            GPIO number for the boot button used to trigger scan mode from deep sleep.
            Default is 0 for ESP32/S2/S3, 9 for C2/C3/C6/H2.

    config LOCATOR_LED_GPIO
        int "Board LED GPIO number"
        default 8 if IDF_TARGET_ESP32C3 || IDF_TARGET_ESP32C2 || IDF_TARGET_ESP32C6 || IDF_TARGET_ESP32H2
        default 2
        help
            GPIO number for the onboard LED.
            Default is 2 for ESP32/S2/S3, 8 for C2/C3/C6/H2.

    config LOCATOR_LED_ACTIVE_LOW
        bool "LED is active-low"
        default y if IDF_TARGET_ESP32C3 || IDF_TARGET_ESP32C2 || IDF_TARGET_ESP32C6 || IDF_TARGET_ESP32H2
        default n
        help
            Enable if the onboard LED is active-low (GPIO low = LED on).
            This is typically the case on ESP32-C3, C6, and similar boards.

    config LOCATOR_OPEN_WIFI_ENABLED
        bool "Enable opportunistic open WiFi connection"
        default y
        help
            When enabled, scan mode will attempt to connect to open WiFi
            networks after scanning, sync time via SNTP, and invoke a
            user-defined hook before going back to deep sleep.

endmenu
```

## sdkconfig.defaults
```kconfig
CONFIG_ESPTOOLPY_FLASHSIZE_4MB=y
CONFIG_PARTITION_TABLE_CUSTOM=y
CONFIG_PARTITION_TABLE_CUSTOM_FILENAME="partitions.csv"
CONFIG_MBEDTLS_CERTIFICATE_BUNDLE=y
CONFIG_MBEDTLS_CERTIFICATE_BUNDLE_DEFAULT_FULL=y
CONFIG_ESP_WIFI_SCANLIST_SORT_RSSI=y
CONFIG_LOG_DEFAULT_LEVEL_WARN=y
CONFIG_LOG_DEFAULT_LEVEL=2
CONFIG_ESP_MAIN_TASK_STACK_SIZE=8192

# Lower brownout threshold for boards with weak voltage regulators (e.g. C3 Super Mini).
# Level 7 (default) is too sensitive and causes resets during WiFi TX current spikes.
CONFIG_ESP_BROWNOUT_DET_LVL_SEL_2=y
CONFIG_ESP_BROWNOUT_DET_LVL=2
```
